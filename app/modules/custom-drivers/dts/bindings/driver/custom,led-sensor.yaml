## app/modules/custom-drivers/dts/bindings/driver/custom,led-sensor.yaml
```yaml
description: Custom GPIO LED Sensor

compatible: "custom,led-sensor"

properties:
  gpios:
    type: phandle-array
    required: true
  init-delay-ms:
    type: int
    default: 500
    description: Valor inicial del delay del blink del led.
```

## twister-out.1/native_sim_native/host/homework.unit.ring_buf/Kconfig/arch/Kconfig
```kconfig
# Load Zephyr Arch Kconfig descriptions.
osource "/home/mauro/IOMICO/deps/zephyr/arch/rx/Kconfig"
osource "/home/mauro/IOMICO/deps/zephyr/arch/x86/Kconfig"
osource "/home/mauro/IOMICO/deps/zephyr/arch/xtensa/Kconfig"
osource "/home/mauro/IOMICO/deps/zephyr/arch/sparc/Kconfig"
osource "/home/mauro/IOMICO/deps/zephyr/arch/riscv/Kconfig"
osource "/home/mauro/IOMICO/deps/zephyr/arch/posix/Kconfig"
osource "/home/mauro/IOMICO/deps/zephyr/arch/mips/Kconfig"
osource "/home/mauro/IOMICO/deps/zephyr/arch/arm64/Kconfig"
osource "/home/mauro/IOMICO/deps/zephyr/arch/arm/Kconfig"
osource "/home/mauro/IOMICO/deps/zephyr/arch/arc/Kconfig"
```

## twister-out.1/native_sim_native/host/homework.unit.ring_buf/Kconfig/boards/Kconfig
```kconfig
# Load Zephyr board Kconfig descriptions.
osource "/home/mauro/IOMICO/deps/zephyr/boards/native/native_sim/Kconfig"
```

## twister-out.1/native_sim_native/host/homework.unit.ring_buf/Kconfig/boards/Kconfig.native_sim
```kconfig
# Load board Kconfig descriptions.
osource "/home/mauro/IOMICO/deps/zephyr/boards/native/native_sim/Kconfig.native_sim"
```

## twister-out.1/native_sim_native/host/homework.unit.ring_buf/Kconfig/boards/Kconfig.sysbuild
```kconfig
# Load Sysbuild board Kconfig descriptions.
osource "/home/mauro/IOMICO/deps/zephyr/boards/native/native_sim/Kconfig.sysbuild"
```

## twister-out/native_sim_native/host/homework.unit.ring_buf/Kconfig/Kconfig.modules
```kconfig
menu "cmsis_6 (/home/mauro/IOMICO/deps/modules/hal/cmsis_6)"
osource "$(ZEPHYR_CMSIS_6_KCONFIG)"
config ZEPHYR_CMSIS_6_MODULE
	bool
	default y
endmenu
menu "hal_espressif (/home/mauro/IOMICO/deps/modules/hal/espressif)"
osource "/home/mauro/IOMICO/deps/modules/hal/espressif/zephyr/Kconfig"
config ZEPHYR_HAL_ESPRESSIF_MODULE
	bool
	default y

config ZEPHYR_HAL_ESPRESSIF_MODULE_BLOBS
	bool
endmenu
menu "hal_nxp (/home/mauro/IOMICO/deps/modules/hal/nxp)"
osource "$(ZEPHYR_HAL_NXP_KCONFIG)"
config ZEPHYR_HAL_NXP_MODULE
	bool
	default y

config ZEPHYR_HAL_NXP_MODULE_BLOBS
	bool
endmenu
config ZEPHYR_HAL_STM32_MODULE
	bool
	default y

config ZEPHYR_HAL_STM32_MODULE_BLOBS
	bool
```

## twister-out/native_sim_native/host/homework.unit.ring_buf/Kconfig/boards/Kconfig.defconfig
```kconfig
# Load Zephyr board defconfig descriptions.
osource "/home/mauro/IOMICO/deps/zephyr/boards/native/native_sim/Kconfig.defconfig"
```
