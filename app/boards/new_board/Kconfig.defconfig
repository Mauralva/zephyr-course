## app/boards/new_board/Kconfig.new_board
```kconfig
config BOARD_NEW_BOARD
    bool "New Board From Scratch"
    default y
    help
      New Board From Scratch is a custom board based on the STM32G031K8 MCU.
    select SOC_STM32G031XX 
```

## app/boards/new_board/board.yml
```yaml
board:
  name: new_board
  full_name: New Board From Scratch
  vendor: mauro
  socs:
    - name: stm32g031xx
```

## app/boards/our_board/Kconfig.our_board
```kconfig
# Copyright (c) 2022 Joylab AG <team@joylab.ch>
# SPDX-License-Identifier: Apache-2.0

config BOARD_OUR_BOARD
	bool "Our Board"
	help
	  Our Board is a custom board based on the STM32G031K8 MCU.
	select SOC_STM32G031XX
```

## app/boards/our_board/board.yml
```yaml
board:
  name: our_board
  full_name: Our Board
  vendor: mauro
  socs:
    - name: stm32g031xx
```

## app/boards/st/nucleo_g031k8_custom/board.yml
```yaml
board:
  name: nucleo_g031k8_custom
  full_name: Customizada de Nucleo G031K8
  vendor: Mauro
  socs:
    - name: stm32g031xx
```

## app/modules/custom-drivers/drivers/led_sensor/Kconfig
```kconfig
menuconfig CUSTOM_LED_SENSOR
	bool "Custom GPIO LED Sensor"
	default y
	depends on DT_HAS_CUSTOM_LED_SENSOR_ENABLED
	select GPIO
	help
	  Custom driver para un GPIO LED mediante un Sensor API.
```

## app/modules/custom-drivers/dts/bindings/driver/custom,led-sensor.yaml
```yaml
description: Custom GPIO LED Sensor

compatible: "custom,led-sensor"

properties:
  gpios:
    type: phandle-array
    required: true
```
